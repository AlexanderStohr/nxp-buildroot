## configs/s32v234_defconfig
```kconfig
BR2_aarch64=y
BR2_CCACHE=y
BR2_TOOLCHAIN_EXTERNAL=y
BR2_TARGET_GENERIC_HOSTNAME="treerunner"
BR2_TARGET_GENERIC_ISSUE="Freescale Treerunner Linux BSP"
BR2_INIT_SYSV=y
BR2_TARGET_GENERIC_GETTY_PORT="ttyLF0"
BR2_PACKAGE_I2C_TOOLS=y
BR2_PACKAGE_CAN_UTILS=y
BR2_PACKAGE_DHCPCD=y
BR2_PACKAGE_IFUPDOWN=y
BR2_PACKAGE_IPERF=y
BR2_PACKAGE_IPROUTE2=y
BR2_PACKAGE_OPENSSH=y
BR2_PACKAGE_HOST_MKE2IMG=y
```
